## buildroot-external/configs/raspmatic_rpi3_defconfig
```kconfig
BR2_arm=y
BR2_cortex_a7=y
BR2_ARM_FPU_NEON_VFPV4=y
BR2_DL_DIR="$(TOPDIR)/../download"
BR2_KERNEL_MIRROR="https://www.kernel.org/pub"
BR2_GNU_MIRROR="http://ftp.gnu.org/pub/gnu"
BR2_OPTIMIZE_2=y
BR2_GLOBAL_PATCH_DIR="$(BR2_EXTERNAL_EQ3_PATH)/patches"
# BR2_COMPILER_PARANOID_UNSAFE_PATH is not set
BR2_TOOLCHAIN_BUILDROOT_GLIBC=y
BR2_PACKAGE_HOST_LINUX_HEADERS_CUSTOM_5_4=y
BR2_PACKAGE_GLIBC_UTILS=y
BR2_TOOLCHAIN_BUILDROOT_CXX=y
BR2_TARGET_GENERIC_HOSTNAME=""
BR2_TARGET_GENERIC_ISSUE="Welcome to RaspberryMatic"
BR2_TARGET_GENERIC_PASSWD_SHA512=y
BR2_ROOTFS_DEVICE_CREATION_DYNAMIC_EUDEV=y
# BR2_ENABLE_LOCALE_PURGE is not set
BR2_TARGET_LOCALTIME="Europe/Berlin"
BR2_ROOTFS_OVERLAY="$(BR2_EXTERNAL_EQ3_PATH)/overlay/base $(BR2_EXTERNAL_EQ3_PATH)/overlay/base-raspmatic $(BR2_EXTERNAL_EQ3_PATH)/overlay/WebUI $(BR2_EXTERNAL_EQ3_PATH)/overlay/WebUI-raspmatic $(BR2_EXTERNAL_EQ3_PATH)/overlay/RFD"
BR2_ROOTFS_POST_BUILD_SCRIPT="$(BR2_EXTERNAL_EQ3_PATH)/board/raspberrypi3/post-build.sh"
BR2_ROOTFS_POST_IMAGE_SCRIPT="$(BR2_EXTERNAL_EQ3_PATH)/board/raspberrypi3/post-image.sh"
BR2_LINUX_KERNEL=y
BR2_LINUX_KERNEL_CUSTOM_TARBALL=y
BR2_LINUX_KERNEL_CUSTOM_TARBALL_LOCATION="$(call github,raspberrypi,linux,raspberrypi-kernel_1.20200819-1)/linux-raspberrypi-kernel_1.20200819-1.tar.gz"
BR2_LINUX_KERNEL_PATCH="$(BR2_EXTERNAL_EQ3_PATH)/board/raspberrypi3/kernel-patches"
BR2_LINUX_KERNEL_USE_CUSTOM_CONFIG=y
BR2_LINUX_KERNEL_CUSTOM_CONFIG_FILE="$(BR2_EXTERNAL_EQ3_PATH)/board/raspberrypi3/kernel_defconfig"
BR2_LINUX_KERNEL_LZ4=y
BR2_LINUX_KERNEL_DTS_SUPPORT=y
BR2_LINUX_KERNEL_INTREE_DTS_NAME="bcm2710-rpi-3-b-plus bcm2710-rpi-3-b bcm2710-rpi-2-b bcm2709-rpi-2-b bcm2710-rpi-cm3"
BR2_LINUX_KERNEL_NEEDS_HOST_OPENSSL=y
BR2_PACKAGE_LINUX_TOOLS_GPIO=y
BR2_PACKAGE_BUSYBOX_CONFIG="$(BR2_EXTERNAL_EQ3_PATH)/Busybox.config"
BR2_PACKAGE_BUSYBOX_SHOW_OTHERS=y
BR2_PACKAGE_STRACE=y
BR2_PACKAGE_GIT=y
BR2_PACKAGE_JQ=y
BR2_PACKAGE_MAKE=y
BR2_PACKAGE_SED=y
BR2_PACKAGE_DOSFSTOOLS=y
BR2_PACKAGE_DOSFSTOOLS_FATLABEL=y
BR2_PACKAGE_DOSFSTOOLS_FSCK_FAT=y
BR2_PACKAGE_DOSFSTOOLS_MKFS_FAT=y
BR2_PACKAGE_E2FSPROGS=y
BR2_PACKAGE_E2FSPROGS_E4DEFRAG=y
BR2_PACKAGE_E2FSPROGS_RESIZE2FS=y
BR2_PACKAGE_EXFAT=y
BR2_PACKAGE_EXFAT_UTILS=y
BR2_PACKAGE_F2FS_TOOLS=y
BR2_PACKAGE_NTFS_3G=y
BR2_PACKAGE_DEJAVU=y
BR2_PACKAGE_LIBERATION=y
BR2_PACKAGE_PSPLASH=y
BR2_PACKAGE_PSPLASH_PATCH="$(BR2_EXTERNAL_EQ3_PATH)/patches/psplash/raspmatic"
BR2_PACKAGE_LINUX_FIRMWARE=y
BR2_PACKAGE_LINUX_FIRMWARE_RALINK_RT61=y
BR2_PACKAGE_LINUX_FIRMWARE_RALINK_RT73=y
BR2_PACKAGE_LINUX_FIRMWARE_RALINK_RT2XX=y
BR2_PACKAGE_LINUX_FIRMWARE_RTL_81XX=y
BR2_PACKAGE_LINUX_FIRMWARE_RTL_87XX=y
BR2_PACKAGE_LINUX_FIRMWARE_RTL_88XX=y
BR2_PACKAGE_RPI_BT_FIRMWARE=y
BR2_PACKAGE_RPI_FIRMWARE=y
BR2_PACKAGE_RPI_FIRMWARE_VERSION="1.20200819"
BR2_PACKAGE_RPI_WIFI_FIRMWARE=y
BR2_PACKAGE_I2C_TOOLS=y
BR2_PACKAGE_PARTED=y
BR2_PACKAGE_RNG_TOOLS=y
BR2_PACKAGE_RPI_USERLAND=y
BR2_PACKAGE_SMARTMONTOOLS=y
BR2_PACKAGE_UBOOT_TOOLS=y
BR2_PACKAGE_UBOOT_TOOLS_MKIMAGE=y
BR2_PACKAGE_UBOOT_TOOLS_MKENVIMAGE=y
BR2_PACKAGE_UBOOT_TOOLS_DUMPIMAGE=y
BR2_PACKAGE_USB_MODESWITCH_DATA=y
BR2_PACKAGE_USBMOUNT=y
BR2_PACKAGE_NODEJS=y
BR2_PACKAGE_NODEJS_NPM=y
BR2_PACKAGE_NODEJS_MODULES_ADDITIONAL="async accepts mc charenc encodeurl inherits moment range-parser unorm adm-zip compress-commons end-of-stream ipaddr.js moment-timezone raw-body unpipe archiver concat-map escape-html is-buffer ms readable-stream url archiver-utils content-disposition etag isarray negotiator remove-trailing-separator util-deprecate array-flatten content-type express jmespath node-dir safe-buffer utils-merge async cookie finalhandler jsonfile node-localstorage sax uuid aws-sdk cookie-signature forwarded lazystream normalize-path send vary balanced-match core-util-is fresh lodash on-finished serve-static walkdir base64-js crc fs-extra loop-protect once setprototypeof winreg big-integer crc32-stream fs.realpath md5 parseurl slide wrappy bl cron glob media-typer path-is-absolute statuses write-file-atomic body-parser crypt graceful-fs merge-descriptors path-to-regexp string_decoder ws brace-expansion crypto-browserify http-errors methods process-nextick-args suncalc xml2js buffer debug iconv-lite mime proxy-addr tar-stream xmlbuilder buffer-crc32 depd ieee754 mime-db punycode type-is xtend buffer-shims destroy imurmurhash mime-types qs ultron zip-stream bytes ee-first inflight minimatch querystring universalify"
BR2_PACKAGE_PYTHON3=y
BR2_PACKAGE_PYTHON3_BZIP2=y
BR2_PACKAGE_PYTHON3_DECIMAL=y
BR2_PACKAGE_PYTHON_AIOBLESCAN=y
BR2_PACKAGE_PYTHON_AIOCOAP=y
BR2_PACKAGE_PYTHON_AIOHTTP_CORS=y
BR2_PACKAGE_PYTHON_AIOHTTP_DEBUGTOOLBAR=y
BR2_PACKAGE_PYTHON_AIOHTTP_MAKO=y
BR2_PACKAGE_PYTHON_AIOHTTP_REMOTES=y
BR2_PACKAGE_PYTHON_AIOHTTP_SECURITY=y
BR2_PACKAGE_PYTHON_AIOHTTP_SESSION=y
BR2_PACKAGE_PYTHON_AIOHTTP_SSE=y
BR2_PACKAGE_PYTHON_AIOJOBS=y
BR2_PACKAGE_PYTHON_AIOLOGSTASH=y
BR2_PACKAGE_PYTHON_AIOMONITOR=y
BR2_PACKAGE_PYTHON_AIORWLOCK=y
BR2_PACKAGE_PYTHON_AIOSIGNAL=y
BR2_PACKAGE_PYTHON_AIOZIPKIN=y
BR2_PACKAGE_PYTHON_ALSAAUDIO=y
BR2_PACKAGE_PYTHON_ARGON2_CFFI=y
BR2_PACKAGE_PYTHON_ARROW=y
BR2_PACKAGE_PYTHON_ASYNC_LRU=y
BR2_PACKAGE_PYTHON_AVRO=y
BR2_PACKAGE_PYTHON_BLUEZERO=y
BR2_PACKAGE_PYTHON_BOTTLE=y
BR2_PACKAGE_PYTHON_BROTLI=y
BR2_PACKAGE_PYTHON_BUNCH=y
BR2_PACKAGE_PYTHON_CACHED_PROPERTY=y
BR2_PACKAGE_PYTHON_CANOPEN=y
BR2_PACKAGE_PYTHON_CHANNELS_REDIS=y
BR2_PACKAGE_PYTHON_CHEETAH=y
BR2_PACKAGE_PYTHON_CHERRYPY=y
BR2_PACKAGE_PYTHON_COLORAMA=y
BR2_PACKAGE_PYTHON_CONFIGSHELL_FB=y
BR2_PACKAGE_PYTHON_CRCMOD=y
BR2_PACKAGE_PYTHON_CRONTAB=y
BR2_PACKAGE_PYTHON_CROSSBAR=y
BR2_PACKAGE_PYTHON_DAEMON=y
BR2_PACKAGE_PYTHON_DAEMONIZE=y
BR2_PACKAGE_PYTHON_DIALOG3=y
BR2_PACKAGE_PYTHON_DICTTOXML=y
BR2_PACKAGE_PYTHON_DJANGO_ENUMFIELDS=y
BR2_PACKAGE_PYTHON_DNSPYTHON=y
BR2_PACKAGE_PYTHON_DOCKER=y
BR2_PACKAGE_PYTHON_DOCKER_PYCREDS=y
BR2_PACKAGE_PYTHON_DOCKERPTY=y
BR2_PACKAGE_PYTHON_DOCOPT=y
BR2_PACKAGE_PYTHON_DOMINATE=y
BR2_PACKAGE_PYTHON_DPKT=y
BR2_PACKAGE_PYTHON_ESPTOOL=y
BR2_PACKAGE_PYTHON_FALCON=y
BR2_PACKAGE_PYTHON_FILELOCK=y
BR2_PACKAGE_PYTHON_FIRE=y
BR2_PACKAGE_PYTHON_FLASK_BABEL=y
BR2_PACKAGE_PYTHON_FLASK_CORS=y
BR2_PACKAGE_PYTHON_FLASK_JSONRPC=y
BR2_PACKAGE_PYTHON_FLASK_LOGIN=y
BR2_PACKAGE_PYTHON_FLASK_SQLALCHEMY=y
BR2_PACKAGE_PYTHON_FLATBUFFERS=y
BR2_PACKAGE_PYTHON_FUTURE=y
BR2_PACKAGE_PYTHON_GITDB2=y
BR2_PACKAGE_PYTHON_GOBJECT=y
BR2_PACKAGE_PYTHON_GPIOZERO=y
BR2_PACKAGE_PYTHON_GREENLET=y
BR2_PACKAGE_PYTHON_GUNICORN=y
BR2_PACKAGE_PYTHON_HTML5LIB=y
BR2_PACKAGE_PYTHON_HTTPLIB2=y
BR2_PACKAGE_PYTHON_HUEPY=y
BR2_PACKAGE_PYTHON_HUMANIZE=y
BR2_PACKAGE_PYTHON_IBMIOTF=y
BR2_PACKAGE_PYTHON_INFLECTION=y
BR2_PACKAGE_PYTHON_INFLUXDB=y
BR2_PACKAGE_PYTHON_INIPARSE=y
BR2_PACKAGE_PYTHON_IOWAIT=y
BR2_PACKAGE_PYTHON_IPTABLES=y
BR2_PACKAGE_PYTHON_IPYTHON=y
BR2_PACKAGE_PYTHON_JANUS=y
BR2_PACKAGE_PYTHON_JSON_SCHEMA_VALIDATOR=y
BR2_PACKAGE_PYTHON_JSONMODELS=y
BR2_PACKAGE_PYTHON_KEYRING=y
BR2_PACKAGE_PYTHON_LIBCONFIG=y
BR2_PACKAGE_PYTHON_LIBUSB1=y
BR2_PACKAGE_PYTHON_LOGBOOK=y
BR2_PACKAGE_PYTHON_M2R=y
BR2_PACKAGE_PYTHON_MARKDOWN2=y
BR2_PACKAGE_PYTHON_MATPLOTLIB=y
BR2_PACKAGE_PYTHON_MELD3=y
BR2_PACKAGE_PYTHON_MIMEPARSE=y
BR2_PACKAGE_PYTHON_MODBUS_TK=y
BR2_PACKAGE_PYTHON_MUTAGEN=y
BR2_PACKAGE_PYTHON_MWCLIENT=y
BR2_PACKAGE_PYTHON_MWSCRAPE2SLOB=y
BR2_PACKAGE_PYTHON_NESTED_DICT=y
BR2_PACKAGE_PYTHON_NETIFACES=y
BR2_PACKAGE_PYTHON_NETWORKX=y
BR2_PACKAGE_PYTHON_PERIPHERY=y
BR2_PACKAGE_PYTHON_PIGPIO=y
BR2_PACKAGE_PYTHON_PILLOW=y
BR2_PACKAGE_PYTHON_PIP=y
BR2_PACKAGE_PYTHON_POSIX_IPC=y
BR2_PACKAGE_PYTHON_PROTOBUF=y
BR2_PACKAGE_PYTHON_PSYCOPG2=y
BR2_PACKAGE_PYTHON_PUDB=y
BR2_PACKAGE_PYTHON_PY=y
BR2_PACKAGE_PYTHON_PYALSA=y
BR2_PACKAGE_PYTHON_PYBIND=y
BR2_PACKAGE_PYTHON_PYCAIRO=y
BR2_PACKAGE_PYTHON_PYCLI=y
BR2_PACKAGE_PYTHON_PYDAL=y
BR2_PACKAGE_PYTHON_PYDANTIC=y
BR2_PACKAGE_PYTHON_PYELFTOOLS=y
BR2_PACKAGE_PYTHON_PYFTPDLIB=y
BR2_PACKAGE_PYTHON_PYINOTIFY=y
BR2_PACKAGE_PYTHON_PYJWT=y
BR2_PACKAGE_PYTHON_PYLIBFTDI=y
BR2_PACKAGE_PYTHON_PYLRU=y
BR2_PACKAGE_PYTHON_PYMODBUS=y
BR2_PACKAGE_PYTHON_PYMYSQL=y
BR2_PACKAGE_PYTHON_PYRATEMP=y
BR2_PACKAGE_PYTHON_PYROUTE2=y
BR2_PACKAGE_PYTHON_PYSENDFILE=y
BR2_PACKAGE_PYTHON_PYSFTP=y
BR2_PACKAGE_PYTHON_PYSMB=y
BR2_PACKAGE_PYTHON_PYSNMP_MIBS=y
BR2_PACKAGE_PYTHON_PYSOCKS=y
BR2_PACKAGE_PYTHON_PYTABLEREADER=y
BR2_PACKAGE_PYTHON_PYTABLEWRITER=y
BR2_PACKAGE_PYTHON_PYUDEV=y
BR2_PACKAGE_PYTHON_PYUSB=y
BR2_PACKAGE_PYTHON_PYXB=y
BR2_PACKAGE_PYTHON_PYZMQ=y
BR2_PACKAGE_PYTHON_RAVEN=y
BR2_PACKAGE_PYTHON_REDIS=y
BR2_PACKAGE_PYTHON_REENTRY=y
BR2_PACKAGE_PYTHON_REGEX=y
BR2_PACKAGE_PYTHON_REMI=y
BR2_PACKAGE_PYTHON_REQUEST_ID=y
BR2_PACKAGE_PYTHON_RPI_WS281X=y
BR2_PACKAGE_PYTHON_RTSLIB_FB=y
BR2_PACKAGE_PYTHON_SCANDIR=y
BR2_PACKAGE_PYTHON_SCAPY=y
BR2_PACKAGE_PYTHON_SCHEDULE=y
BR2_PACKAGE_PYTHON_SEE=y
BR2_PACKAGE_PYTHON_SEMVER=y
BR2_PACKAGE_PYTHON_SENTRY_SDK=y
BR2_PACKAGE_PYTHON_SERIAL_ASYNCIO=y
BR2_PACKAGE_PYTHON_SH=y
BR2_PACKAGE_PYTHON_SHUTILWHICH=y
BR2_PACKAGE_PYTHON_SIMPLEAUDIO=y
BR2_PACKAGE_PYTHON_SIMPLEGENERIC=y
BR2_PACKAGE_PYTHON_SIMPLEJSON=y
BR2_PACKAGE_PYTHON_SIMPLELOGGING=y
BR2_PACKAGE_PYTHON_SIMPLESQLITE=y
BR2_PACKAGE_PYTHON_SMBUS_CFFI=y
BR2_PACKAGE_PYTHON_SNAPPY=y
BR2_PACKAGE_PYTHON_SOCKETIO=y
BR2_PACKAGE_PYTHON_SOCKJS=y
BR2_PACKAGE_PYTHON_SPIDEV=y
BR2_PACKAGE_PYTHON_TEXTTABLE=y
BR2_PACKAGE_PYTHON_THRIFT=y
BR2_PACKAGE_PYTHON_TINYRPC=y
BR2_PACKAGE_PYTHON_TOMAKO=y
BR2_PACKAGE_PYTHON_TOML=y
BR2_PACKAGE_PYTHON_TQDM=y
BR2_PACKAGE_PYTHON_TWISTED_HTTP2=y
BR2_PACKAGE_PYTHON_TXDBUS=y
BR2_PACKAGE_PYTHON_UJSON=y
BR2_PACKAGE_PYTHON_UVLOOP=y
BR2_PACKAGE_PYTHON_VALIDATORS=y
BR2_PACKAGE_PYTHON_VERSIONTOOLS=y
BR2_PACKAGE_PYTHON_VISITOR=y
BR2_PACKAGE_PYTHON_WEBPY=y
BR2_PACKAGE_PYTHON_WEBSOCKETS=y
BR2_PACKAGE_PYTHON_WHOOSH=y
BR2_PACKAGE_PYTHON_WS4PY=y
BR2_PACKAGE_PYTHON_WSACCEL=y
BR2_PACKAGE_PYTHON_WTFORMS=y
BR2_PACKAGE_PYTHON_XLIB=y
BR2_PACKAGE_PYTHON_XLSXWRITER=y
BR2_PACKAGE_PYTHON_XLUTILS=y
BR2_PACKAGE_PYTHON_XMLTODICT=y
BR2_PACKAGE_PYTHON_YATL=y
BR2_PACKAGE_PYTHON_ZC_LOCKFILE=y
BR2_PACKAGE_PYTHON_ZEROCONF=y
BR2_PACKAGE_CA_CERTIFICATES=y
BR2_PACKAGE_LIBOPENSSL_BIN=y
BR2_PACKAGE_REDIS=y
BR2_PACKAGE_SQLITE_STAT4=y
BR2_PACKAGE_SQLITE_ENABLE_COLUMN_METADATA=y
BR2_PACKAGE_SQLITE_ENABLE_FTS3=y
BR2_PACKAGE_SQLITE_ENABLE_JSON1=y
BR2_PACKAGE_SQLITE_ENABLE_UNLOCK_NOTIFY=y
BR2_PACKAGE_SQLITE_SECURE_DELETE=y
BR2_PACKAGE_DTC=y
BR2_PACKAGE_LIBGPIOD=y
BR2_PACKAGE_LIBGPIOD_TOOLS=y
BR2_PACKAGE_LIBCURL=y
BR2_PACKAGE_LIBCURL_CURL=y
BR2_PACKAGE_LIBNETFILTER_CONNTRACK=y
BR2_PACKAGE_MSMTP=y
BR2_PACKAGE_AVAHI=y
BR2_PACKAGE_BLUEZ5_UTILS=y
BR2_PACKAGE_BLUEZ5_UTILS_OBEX=y
BR2_PACKAGE_BLUEZ5_UTILS_CLIENT=y
BR2_PACKAGE_BLUEZ5_UTILS_DEPRECATED=y
BR2_PACKAGE_CHRONY=y
BR2_PACKAGE_ETHTOOL=y
BR2_PACKAGE_IFPLUGD=y
BR2_PACKAGE_IW=y
BR2_PACKAGE_LIGHTTPD=y
BR2_PACKAGE_LIGHTTPD_OPENSSL=y
BR2_PACKAGE_LIGHTTPD_ZLIB=y
BR2_PACKAGE_LIGHTTPD_PCRE=y
BR2_PACKAGE_NETSNMP=y
BR2_PACKAGE_NETSNMP_WITH_MIB_MODULES="host ucd-snmp/dlmod ucd-snmp/diskio ucd-snmp/extensible ucd-snmp/pass mibII/mta_sendmail etherlike-mib/dot3StatsTable disman/event-mib agentx"
BR2_PACKAGE_NTP=y
# BR2_PACKAGE_NTP_NTPD is not set
BR2_PACKAGE_NTP_NTPDATE=y
BR2_PACKAGE_OPENSSH=y
BR2_PACKAGE_OPENVPN=y
BR2_PACKAGE_RSYNC=y
BR2_PACKAGE_SER2NET=y
BR2_PACKAGE_SOCAT=y
BR2_PACKAGE_TCPDUMP=y
BR2_PACKAGE_WGET=y
BR2_PACKAGE_WIREGUARD_LINUX_COMPAT=y
BR2_PACKAGE_WIREGUARD_TOOLS=y
BR2_PACKAGE_WPA_SUPPLICANT=y
BR2_PACKAGE_WPA_SUPPLICANT_AP_SUPPORT=y
BR2_PACKAGE_WPA_SUPPLICANT_AUTOSCAN=y
BR2_PACKAGE_WPA_SUPPLICANT_EAP=y
BR2_PACKAGE_WPA_SUPPLICANT_HOTSPOT=y
BR2_PACKAGE_WPA_SUPPLICANT_DEBUG_SYSLOG=y
BR2_PACKAGE_WPA_SUPPLICANT_WPS=y
BR2_PACKAGE_WPA_SUPPLICANT_WPA3=y
BR2_PACKAGE_WPA_SUPPLICANT_CLI=y
BR2_PACKAGE_WPA_SUPPLICANT_PASSPHRASE=y
BR2_PACKAGE_WPA_SUPPLICANT_DBUS=y
BR2_PACKAGE_WPA_SUPPLICANT_DBUS_INTROSPECTION=y
BR2_PACKAGE_XINETD=y
BR2_PACKAGE_BASH=y
BR2_PACKAGE_FILE=y
BR2_PACKAGE_LOGROTATE=y
BR2_PACKAGE_IRQBALANCE=y
BR2_PACKAGE_KMOD_TOOLS=y
BR2_PACKAGE_MONIT=y
BR2_PACKAGE_NUT=y
BR2_PACKAGE_TAR=y
BR2_PACKAGE_UTIL_LINUX_BINARIES=y
BR2_PACKAGE_UTIL_LINUX_LOSETUP=y
BR2_PACKAGE_UTIL_LINUX_RFKILL=y
BR2_PACKAGE_VIM=y
BR2_TARGET_ROOTFS_EXT2=y
BR2_TARGET_ROOTFS_EXT2_4=y
BR2_TARGET_ROOTFS_EXT2_SIZE="1G"
BR2_TARGET_ROOTFS_EXT2_MKFS_OPTIONS=""
# BR2_TARGET_ROOTFS_TAR is not set
BR2_TARGET_UBOOT=y
BR2_TARGET_UBOOT_BUILD_SYSTEM_KCONFIG=y
BR2_TARGET_UBOOT_CUSTOM_VERSION=y
BR2_TARGET_UBOOT_CUSTOM_VERSION_VALUE="2020.01"
BR2_TARGET_UBOOT_PATCH="$(BR2_EXTERNAL_EQ3_PATH)/board/raspberrypi3/uboot-patches"
BR2_TARGET_UBOOT_USE_CUSTOM_CONFIG=y
BR2_TARGET_UBOOT_CUSTOM_CONFIG_FILE="$(BR2_EXTERNAL_EQ3_PATH)/board/raspberrypi3/uboot_defconfig"
BR2_TARGET_UBOOT_NEEDS_DTC=y
BR2_TARGET_UBOOT_BOOT_SCRIPT=y
BR2_TARGET_UBOOT_BOOT_SCRIPT_SOURCE="$(BR2_EXTERNAL_EQ3_PATH)/board/raspberrypi3/boot.cmd"
BR2_PACKAGE_HOST_DOSFSTOOLS=y
BR2_PACKAGE_HOST_GENIMAGE=y
BR2_PACKAGE_HOST_MTOOLS=y
BR2_PACKAGE_HOST_PYTHON3=y
BR2_PACKAGE_HOST_UBOOT_TOOLS=y
BR2_PACKAGE_RECOVERY_SYSTEM=y
BR2_PACKAGE_RECOVERY_SYSTEM_CONFIG="recovery_rpi3_defconfig"
BR2_PACKAGE_OCCU=y
BR2_PACKAGE_OCCU_RF_PROTOCOL_HM_HMIP=y
BR2_PACKAGE_OCCU_WEBUI=y
BR2_PACKAGE_OCCU_WEBUI_REGAHSS_BETA=y
BR2_PACKAGE_OCCU_HMSERVER=y
BR2_PACKAGE_CLOUDMATIC=y
BR2_PACKAGE_HMLANGW=y
BR2_PACKAGE_GENERIC_RAW_UART=y
BR2_PACKAGE_EQ3_CHAR_LOOP=y
BR2_PACKAGE_RPI_RF_MOD=y
BR2_PACKAGE_SUSVD=y
BR2_PACKAGE_PIUSVD=y
BR2_PACKAGE_PICOD=y
BR2_PACKAGE_STROMPI2D=y
BR2_PACKAGE_PIDESKTOPD=y
BR2_PACKAGE_ARGONONED=y
BR2_PACKAGE_DETECT_RADIO_MODULE=y
BR2_PACKAGE_DAEMONIZE=y
BR2_PACKAGE_SSDPD=y
BR2_PACKAGE_EQ3CONFIGD=y
BR2_PACKAGE_WIRINGPI_RPI=y
BR2_PACKAGE_NEOSERVER=y
BR2_PACKAGE_RNDADDTOENTCNT=y
BR2_PACKAGE_RASPI_FANSHIM=y
BR2_PACKAGE_JAVA_AZUL=y
BR2_PACKAGE_DOTNET_RUNTIME=y
BR2_PACKAGE_HOME_ASSISTANT=y
```

## buildroot-external/package/dotnet-runtime/Config.in
```kconfig
comment "dotnet-runtime needs a toolchain w/ glibc and threads"
        depends on !BR2_TOOLCHAIN_USES_GLIBC

config BR2_PACKAGE_DOTNET_RUNTIME
    bool "dotnet-runtime"
    depends on BR2_TOOLCHAIN_USES_GLIBC
    depends on BR2_TOOLCHAIN_HAS_THREADS
    depends on BR2_PACKAGE_LIBZLIB
    depends on BR2_PACKAGE_OPENSSL
    depends on BR2_PACKAGE_LIBCURL
    depends on BR2_PACKAGE_ICU
    help
      .NET Core 3.1 Runtime (v3.1.7) - Linux ARM32 binaries

      https://dotnet.microsoft.com/download/dotnet-core/3.1
```

## buildroot-external/package/home-assistant/Config.in
```kconfig
config BR2_PACKAGE_HOME_ASSISTANT
	bool "home-assistant"
	depends on BR2_PACKAGE_PYTHON3
	# ACME
	depends on BR2_PACKAGE_PYTHON_AIOHTTP
	depends on BR2_PACKAGE_PYTHON_AIOHTTP_CORS
	# APPDIRS
	# ASTRAL
	depends on BR2_PACKAGE_PYTHON_ASYNC_TIMEOUT
	# ATOMICWRITES
	depends on BR2_PACKAGE_PYTHON_ATTRS
	depends on BR2_PACKAGE_PYTHON_BCRYPT
	depends on BR2_PACKAGE_PYTHON_CERTIFI
	depends on BR2_PACKAGE_PYTHON_CFFI
	depends on BR2_PACKAGE_PYTHON_CHARDET
	depends on BR2_PACKAGE_PYTHON_COLORLOG
	depends on BR2_PACKAGE_PYTHON_CRYPTOGRAPHY
	depends on BR2_PACKAGE_PYTHON_ECDSA
	depends on BR2_PACKAGE_PYTHON_FILELOCK
	depends on BR2_PACKAGE_PYTHON_IDNA
	depends on BR2_PACKAGE_PYTHON_IFADDR
	depends on BR2_PACKAGE_PYTHON_JINJA2
	depends on BR2_PACKAGE_PYTHON_MARKUPSAFE
	depends on BR2_PACKAGE_PYTHON_MULTIDICT
	depends on BR2_PACKAGE_PYTHON_MUTAGEN
	depends on BR2_PACKAGE_PYTHON_PIP
	depends on BR2_PACKAGE_PYTHON_PY
	depends on BR2_PACKAGE_PYTHON_PYASN1
	depends on BR2_PACKAGE_PYTHON_PYCPARSER
	depends on BR2_PACKAGE_PYTHON_PYJWT
	depends on BR2_PACKAGE_PYTHON_PYNACL
	depends on BR2_PACKAGE_PYTHON_PYOPENSSL
	depends on BR2_PACKAGE_PYTHON_PYPARSING
	depends on BR2_PACKAGE_PYTHON_PYTZ
	depends on BR2_PACKAGE_PYTHON_PYYAML
	depends on BR2_PACKAGE_PYTHON_REQUESTS
	depends on BR2_PACKAGE_PYTHON_REQUESTS_TOOLBELT
	depends on BR2_PACKAGE_PYTHON_SETUPTOOLS
	depends on BR2_PACKAGE_PYTHON_SQLALCHEMY
	depends on BR2_PACKAGE_PYTHON_TOML
	depends on BR2_PACKAGE_PYTHON_TQDM
	depends on BR2_PACKAGE_PYTHON_URLLIB3
	depends on BR2_PACKAGE_PYTHON_XMLTODICT
	depends on BR2_PACKAGE_PYTHON_YARL
	depends on BR2_PACKAGE_PYTHON_ZEROCONF
	help
	  Home Assistant
```
